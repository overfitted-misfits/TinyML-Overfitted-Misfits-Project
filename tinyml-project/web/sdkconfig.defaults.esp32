## tinyml-project/web/sdkconfig.defaults.esp32
```kconfig
CONFIG_ESP32_DEFAULT_CPU_FREQ_240=y
CONFIG_ESP32_SPIRAM_SUPPORT=y

CONFIG_CAMERA_MODULE_AI_THINKER=y
CONFIG_S16=y

CONFIG_COMPILER_OPTIMIZATION_SIZE=y

USE_WAKENET=n
USE_MULTINETNET=n
```
